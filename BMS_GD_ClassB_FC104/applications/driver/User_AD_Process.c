#include "GlobalVarShared.h"

volatile rt_uint8_t system_vol_cal;
volatile rt_uint8_t max_vol_cal;
volatile rt_uint8_t min_vol_cal;
volatile rt_uint8_t max_temp_cal;
volatile rt_uint8_t min_temp_cal;
volatile rt_uint8_t current_cal;
volatile rt_uint8_t mos_temp_cal;
rt_uint16_t conunt1 =0;//测试计数
rt_uint16_t Test_Temp = 500;

void AD_To_Temp_OutsideTotalVoltage(void);

//温度表  需与温度NTC规格书对照执行
//HKW- Z221127-01
const rt_uint16_t table_cell_shunt[256]=
{
//ADC    温度  rt
3903,	//-40	0
3892,	//-39	1
3881,	//-38	2
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0,	//215	255

};  
//HK103F4R22-1000GT01
/*const rt_uint16_t table_mos_shunt[256]=
{
3955 , 
3946 ,
3937 ,
3928 ,
3918 ,
3907 ,
3896 ,
3884 ,
3872 ,
3860 ,
3846 ,
3833 ,
3818 ,
3803 ,
3787 ,
3771 ,
3754 ,
3736 ,
3718 ,
3699 ,
3679 ,
3659 ,
3637 ,
3615 ,
3592 ,
3569 ,
3545 ,
3519 ,
3493 ,
3467 ,
3439 ,
3411 ,
3381 ,
3351 ,
3321 ,
3289 ,
3256 ,
3223 ,
3189 ,
3154 ,
3122 ,
3082 ,
3045 ,
3007 ,
2969 ,
2929 ,
2889 ,
2849 ,
2808 ,
2766 ,
2724 ,
2681 ,
2638 ,
2595 ,
2551 ,
2507 ,
2462 ,
2418 ,
2373 ,
2328 ,
2282 ,
2237 ,
2192 ,
2147 ,
2102 ,
2048 ,
2012 ,
1968 ,
1923 ,
1879 ,
1836 ,
1793 ,
1750 ,
1708 ,
1666 ,
1625 ,
1584 ,
1543 ,
1504 ,
1465 ,
1427 ,
1389 ,
1352 ,
1316 ,
1280 ,
1245 ,
1211 ,
1178 ,
1145 ,
1113 ,
1082 ,
1051 ,
1022 ,
993 ,
964 ,
937 ,
910 ,
884 ,
858 ,
834 ,
809 ,
786 ,
763 ,
741 ,
720 ,
699 ,
678 ,
659 ,
639 ,
621 ,
603 ,
586 ,
569 ,
552 ,
536 ,
521 ,
506 ,
491 ,
477 ,
464 ,
450 ,
437 ,
425 ,
413 ,
401 ,
390 ,
379 ,
368 ,
358 ,
348 ,
338 ,
329 ,
319 ,
310 ,
302 ,
294 ,
285 ,
278 ,
270 ,
263 ,
256 ,
249 ,
242 ,
235 ,
229 ,
223 ,
0,0,0,0,0,0,0,0,0,0,
0,0,0,0,0,0,0,0,0,0,
0,0,0,0,0,0,0,0,0,0,
0,0,0,0,0,0,0,0,0,0,
0,0,0,0,0,0,0,0,0,0,
0,0,0,0,0,0,0,0,0,0,
0,0,0,0,0,0,0,0,0,0,
0,0,0,0,0,0,0,0,0,0,
0,0,0,0,0,0,0,0,0,0,
0,0,0,0,0,0,0,0,0,0,
0,0,0,0,0,0,0,0,0,0,

};*/
//二分法查表
static rt_uint16_t check_cell_shunt_tempu(rt_uint16_t h)
{
		rt_uint8_t j;
		rt_uint16_t g,g1,rt,k;

		k=128;
		rt=k;

		for(j=0;(j<10)&&(k>0);j++)
		{
				g=table_cell_shunt[rt];
				if(rt>0)
				{
						g1=table_cell_shunt[rt-1];      
				}
				else
				{
						g1=g;       
				}
				
				k=k>>1;

				if((g<h)&&(h<g1))
				{
						 rt=rt*10;
							if(rt <= 0) rt = 0;
						return rt;           
				}
				else if((g<h)&&(h>g1))
				{
						rt=rt-k; 
						if(k==1)k=2;
				 }
				else if((g>h)&&(h<g1))
				{
						rt=rt+k;
						if(k==1)k=2;
				}
				else
				{
						 rt=rt*10;
							if(rt <= 0) rt = 0;
						return rt;
				}

		}


		rt=rt*10;
		if(rt <= 0) rt = 0;
		
		return rt;
}
//二分法查表
static rt_uint16_t check_mos_shunt_tempu(rt_uint16_t h)
{
        rt_uint8_t j;
        rt_uint16_t g,g1,rt,k;
    
        k=128;
        rt=k;
  
        for(j=0;(j<10)&&(k>0);j++)
        {
                g=table_cell_shunt[rt];
                if(rt>0)
                {
                        g1=table_cell_shunt[rt-1];      
                }
                else
                {
                        g1=g;       
                }
                
                k=k>>1;
    
                if((g<h)&&(h<g1))
                {
                         rt=rt*10;
											  if(rt <= 0) rt = 0;
                        return rt;           
                }
                else if((g<h)&&(h>g1))
                {
                        rt=rt-k; 
                        if(k==1)k=2;
                 }
                else if((g>h)&&(h<g1))
                {
                        rt=rt+k;
                        if(k==1)k=2;
                }
                else
                {
                         rt=rt*10;
												if(rt<=0) rt = 0;
                        return rt;
                }

        }
  
        rt=rt*10;				
				if(rt<=0) rt = 0;
				
        return rt;
}



/*
********************************************************************************************************* 
温度ADC转换、查表、计算最大、最小、平均值
*********************************************************************************************************
*/
void AD_To_Temp_OutsideTotalVoltage(void)
{
		rt_uint8_t i,j;
		rt_uint8_t first_max=0,first_min=0,number_max=0,number_min=0;
		rt_uint16_t max_temp16=0,min_temp16=0,temperature=0;
		rt_uint32_t temp32=0;
		float Vol=0;

		if(Sys_info.member.Temp_Ad_ending)
		{				
					//屏蔽双ADC数据比较功能
//				for(i=0;i<8;i++)
//				{															
//						if(AD_Cell_Temp_Value[i] >= AD_Cell_Temp_Value_ADC2[i])
//						{
//								temp32 = AD_Cell_Temp_Value[i] - AD_Cell_Temp_Value_ADC2[i];									 
//						}									
//						else
//						{
//								temp32 = AD_Cell_Temp_Value_ADC2[i] - AD_Cell_Temp_Value[i];	
//						}
//						
//						if(temp32 > 500)	
//						{
//								Sys_info.member.Temperature_Error = 1;					
//						}
//						else
//						{
//								Sys_info.member.Temperature_Error = 0;						
//						}
//				}				
				
				//8路温度计算                                 
				for(i=0;i<8;i++)
				{									 
						temp32 = AD_Cell_Temp_Value[i];								
						temperature = check_cell_shunt_tempu(temp32); 				//温度对照表  二分法查表 -算法 																
						Sys_info.member.Cell_Temp[i] = temperature;						//正常程序		
					//if(Sys_info.member.Cell_Temp[i]>=590)
					//Sys_info.member.Cell_Temp[i]=Sys_info.member.Cell_Temp[i]+20;	
				}
					
				//计算温度最大最小值    
				for(j=0;j<8;j++)
				{                                      								
							if(first_max==0)
							{
									first_max=1;
									max_temp16=Sys_info.member.Cell_Temp[j];
									number_max=j+1;    //温度点号从1开始     
							}
							else
							{
									if(max_temp16<Sys_info.member.Cell_Temp[j])
									{
										max_temp16=Sys_info.member.Cell_Temp[j];
										number_max=j+1;       
									}
							}
															
							if(first_min==0)
							{
									first_min=1;
									min_temp16=Sys_info.member.Cell_Temp[j];
									number_min=j+1;         
							}
							else
							{
									if(min_temp16>Sys_info.member.Cell_Temp[j])
									{
											min_temp16=Sys_info.member.Cell_Temp[j];
											number_min=j+1;       
									}
							}    
								
				}
										
				Sys_info.member.Cell_Tmp_Max = max_temp16;
				Sys_info.member.Cell_Tmp_Min = min_temp16;
				Sys_info.member.Cell_Tmp_Max_num = number_max; 
				Sys_info.member.Cell_Tmp_Min_num = number_min; 
			 
				//测试代码
//				Sys_info.member.Cell_Tmp_Min = Test_Temp;
				//计算最大最小值温差        
				if(max_temp16>min_temp16)
				{
						Sys_info.member.Cell_Tmp_Deff=max_temp16-min_temp16;      
				}
				else
				{
						Sys_info.member.Cell_Tmp_Deff=0;      
				}
				
				max_temp_cal = 1;
				min_temp_cal = 1;								
						
				//计算MOS温度						
				temp32=AD_MOS_Temp_Value;																																	
				temperature=check_mos_shunt_tempu(temp32); //温度对照表  二分法查表 -算法 														
				Sys_info.member.Mos_Temp=temperature;
				mos_temp_cal=1;													
				
				Sys_info.member.Temp_Ad_ending=0; 
						
						
				//计算外部总压  100ms/次
				Vol=AD_Total_Voltage_Value;
				Vol=Vol*3.3;
				Vol=Vol/4095;
				Vol=10*Vol/0.05;
				Sys_info.member.Pack_Voltage = Vol;							
			}		
}



//----------------------------------------------------------无下文---------------------------------------------------------------------------------

